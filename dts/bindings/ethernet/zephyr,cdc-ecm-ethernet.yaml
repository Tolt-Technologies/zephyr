## dts/bindings/ethernet/zephyr,cdc-ecm-ethernet.yaml
```yaml
# Copyright (c) 2023 Nordic Semiconductor ASA
# SPDX-License-Identifier: Apache-2.0

description: USB CDC ECM virtual Ethernet controller

compatible: "zephyr,cdc-ecm-ethernet"

include: ethernet-controller.yaml

properties:
  remote-mac-address:
    type: string
    required: true
    description: |
      Remote MAC address of the virtual Ethernet connection encoded as
      a string of 12 uppercase hexadecimal characters, for example
      "00005E005301". Do not use colons, dashes, or other separators.
      Per the USB CDC ECM specification (section 5.4), this string is
      sent as-is in the iMACAddress string descriptor to the USB host.
      Should not be the same as local-mac-address property.
```

## dts/bindings/ethernet/zephyr,cdc-ncm-ethernet.yaml
```yaml
# Copyright (c) 2024 Nordic Semiconductor ASA
# SPDX-License-Identifier: Apache-2.0

description: USB CDC NCM virtual Ethernet controller

compatible: "zephyr,cdc-ncm-ethernet"

include: ethernet-controller.yaml

properties:
  remote-mac-address:
    type: string
    required: true
    description: |
      Remote MAC address of the virtual Ethernet connection encoded as
      a string of 12 uppercase hexadecimal characters, for example
      "00005E005301". Do not use colons, dashes, or other separators.
      Per the USB CDC ECM specification (section 5.4), this string is
      sent as-is in the iMACAddress string descriptor to the USB host.
      Should not be the same as local-mac-address property.
```
